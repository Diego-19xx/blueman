## build/Kconfig/Kconfig.modules
```kconfig
menu "cmsis (/home/user/workspace/deps/modules/hal/cmsis)"
osource "$(ZEPHYR_CMSIS_KCONFIG)"
config ZEPHYR_CMSIS_MODULE
	bool
	default y
endmenu
menu "hal_nordic (/home/user/workspace/deps/modules/hal/nordic)"
osource "$(ZEPHYR_HAL_NORDIC_KCONFIG)"
config ZEPHYR_HAL_NORDIC_MODULE
	bool
	default y

config ZEPHYR_HAL_NORDIC_MODULE_BLOBS
	bool
endmenu
menu "segger (/home/user/workspace/deps/modules/debug/segger)"
osource "$(ZEPHYR_SEGGER_KCONFIG)"
config ZEPHYR_SEGGER_MODULE
	bool
	default y
endmenu
```

## build/Kconfig/Kconfig.sysbuild.modules
```kconfig
config ZEPHYR_CMSIS_MODULE
   bool
   default y
config ZEPHYR_HAL_NORDIC_MODULE
   bool
   default y
config ZEPHYR_SEGGER_MODULE
   bool
   default y
```

## build/Kconfig/arch/Kconfig
```kconfig
# Load Zephyr Arch Kconfig descriptions.
osource "/home/user/workspace/deps/zephyr/arch/x86/Kconfig"
osource "/home/user/workspace/deps/zephyr/arch/xtensa/Kconfig"
osource "/home/user/workspace/deps/zephyr/arch/sparc/Kconfig"
osource "/home/user/workspace/deps/zephyr/arch/riscv/Kconfig"
osource "/home/user/workspace/deps/zephyr/arch/posix/Kconfig"
osource "/home/user/workspace/deps/zephyr/arch/nios2/Kconfig"
osource "/home/user/workspace/deps/zephyr/arch/mips/Kconfig"
osource "/home/user/workspace/deps/zephyr/arch/arm64/Kconfig"
osource "/home/user/workspace/deps/zephyr/arch/arm/Kconfig"
osource "/home/user/workspace/deps/zephyr/arch/arc/Kconfig"
```

## build/Kconfig/boards/Kconfig
```kconfig
# Load Zephyr board Kconfig descriptions.
osource "/home/user/workspace/deps/zephyr/boards/nordic/nrf54l15dk/Kconfig"
```

## build/Kconfig/boards/Kconfig.defconfig
```kconfig
# Load Zephyr board defconfig descriptions.
osource "/home/user/workspace/deps/zephyr/boards/nordic/nrf54l15dk/Kconfig.defconfig"
```

## build/Kconfig/boards/Kconfig.nrf54l15dk
```kconfig
# Load board Kconfig descriptions.
osource "/home/user/workspace/deps/zephyr/boards/nordic/nrf54l15dk/Kconfig.nrf54l15dk"
```
